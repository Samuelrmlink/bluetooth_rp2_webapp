## Kconfig
```kconfig
mainmenu "bluetooth_rp2_webapp configuration"

comment "Board / platform"

config BOARD_PICO2_W
    bool "Target: Raspberry Pi Pico 2 W (RP2350A)"
    default y
    help
      The validated target. RP2350A, 520 KB SRAM, 4 MB flash, CYW43439
      dual-mode radio. Unset only when building for an RP2040 Pico W, which
      is supported in principle but not validated.

config BOARD_ESP32_C5
    bool "Target: ESP32-C5"
    default n
    depends on !BOARD_PICO2_W
    help
      ESP32-C5, for 5 GHz Wi-Fi. Specified and not built. Pico cmake still
      configures a Pico board. configs/esp32c5_defconfig waits until an
      ESP-IDF build exists. The order is in docs/Feature-Roadmap.md.

source "src/radio/Kconfig"
source "src/can/Kconfig"
source "src/net/Kconfig"
source "src/bt/Kconfig"
source "src/codec/Kconfig"
source "src/lua/Kconfig"
source "src/io/Kconfig"
source "src/ota/Kconfig"
source "src/sd/Kconfig"
source "src/fs/Kconfig"
source "src/pex/Kconfig"
```

## configs/pico2w_defconfig
```kconfig
CONFIG_BOARD_PICO2_W=y
CONFIG_NET_WIFI=y
CONFIG_NET_USB_NCM=y
CONFIG_NET_NCM_IP0=192
CONFIG_NET_NCM_IP1=168
CONFIG_NET_NCM_IP2=8
CONFIG_NET_MDNS=y
CONFIG_NET_HOSTNAME="bluetooth-rp2-webapp"
CONFIG_LWIP_MEM_SIZE_KB=48
CONFIG_BT_LE=y
CONFIG_BT_MAX_LINKS=4
CONFIG_LUA_ENABLE=y
CONFIG_LUA_HEAP_KB=160
CONFIG_LUA_HOOK_BUDGET=20000
CONFIG_IO_PINS=y
CONFIG_IO_GPIO=y
CONFIG_IO_ADC=y
CONFIG_IO_I2C=y
CONFIG_IO_SPI=y
CONFIG_NET_WIREGUARD=y
CONFIG_OTA=y
# The W5500 Ethernet uplink is opt-in: see pico2w_eth_defconfig.
# CONFIG_NET_ETH_W5500 is not set
```

## esp32c5/main/Kconfig.projbuild
```kconfig
menu "BTGW ESP32-C5"

comment "Station credentials are cfg/wifi.json on the littlefs partition, the same file the RP2350 store writes. This image does not compile a network in. An empty store does not join."

choice C5_RADIO
    prompt "Radio"
    default C5_RADIO_WIFI
    help
      The ESP32-C5 has one 2.4 GHz radio. An image is Wi-Fi or Thread,
      not both. A site runs one board of each image and they meet on
      Ethernet. Software coexistence stays off.

config C5_RADIO_WIFI
    bool "Wi-Fi (station and SoftAP)"
    help
      This image's project name is btgw-esp32c5. 802.15.4 and OpenThread
      stay out of it.

config C5_RADIO_THREAD
    bool "Thread (802.15.4)"
    help
      Specified and not built. Selecting this fails configure. The image
      that eventually builds it is named btgw-esp32c5-thread, so a Wi-Fi
      update cannot arm on a Thread board.

endchoice

config C5_BLE
    bool "NimBLE central and peripheral"
    depends on C5_RADIO_WIFI
    default n
    select BT_ENABLED
    select BT_NIMBLE_SECURITY_ENABLE
    select BT_NIMBLE_SM_SC
    select BT_NIMBLE_NVS_PERSIST
    select BT_NIMBLE_DYNAMIC_SERVICE
    help
      NimBLE central and peripheral. Off in the product Wi-Fi image.
      Incompatible with Thread.

      The security manager and LE Secure Connections come on with this
      symbol. CONFIG_BT_NIMBLE_STATIC_PASSKEY stays off: that option forces
      MITM and injects a passkey even for Just Works. The application
      supplies the passkey when NimBLE raises a passkey action. Bonds are
      stored in NVS. Wi-Fi and BLE share 2.4 GHz through the IDF software
      coexistence NimBLE expects. 802.15.4 stays off.

      The BT host is a Kconfig choice. select and a second default have no
      effect on it, so the BLE image also sets CONFIG_BT_NIMBLE_ENABLED.
      The controller choice already defaults to enabled once Bluetooth is on.

comment "W5500 on SPI2. These pins are the ESP32-C5-DevKitC-1 header, not the Pico wiring. GPIO13/14 are USB, GPIO11/12 are UART0, and GPIO2/3/7/25/26/27/28 are strapping or the RGB LED."

config ETH_W5500_SPI
    int "SPI host (1 = SPI2, the only general-purpose SPI)"
    range 1 1
    default 1

config ETH_W5500_SCK
    int "SCK GPIO"
    range 0 28
    default 8

config ETH_W5500_MOSI
    int "MOSI GPIO"
    range 0 28
    default 23

config ETH_W5500_MISO
    int "MISO GPIO"
    range 0 28
    default 24

config ETH_W5500_CS
    int "CS GPIO (driven as a plain GPIO)"
    range 0 28
    default 10

config ETH_W5500_INT
    int "INT GPIO (-1 = poll only)"
    range -1 28
    default 4

config ETH_W5500_RST
    int "RST GPIO (-1 = soft reset through MR)"
    range -1 28
    default 5

config ETH_W5500_BAUD
    int "SPI clock (Hz)"
    range 1000000 40000000
    default 30000000

config ETH_W5500_MAC_FILTER
    bool "Hardware MAC filter (own MAC + broadcast + multicast only)"
    default y

endmenu
```

## src/bt/Kconfig
```kconfig
menu "Bluetooth"

config BT_LE
    bool "Bluetooth Low Energy (central)"
    default y
    depends on RADIO_CYW43
    help
      Scanning, connecting, GATT discovery, read/write/subscribe and SMP
      bonding, via BTstack's gatt_client. This is the transport the project
      leads with. On the Pico the controller is the CYW43439 (RADIO_CYW43).

config BT_CLASSIC
    bool "Bluetooth Classic (RFCOMM)"
    default n
    depends on BT_LE
    help
      Inquiry, SDP, and one RFCOMM session per link. A PEX module or a
      websocket op supplies the service UUID, the security policy, and any
      PIN. LE central stays available. MAX_NR_HCI_CONNECTIONS is shared,
      so turning this on costs ACL buffer RAM. The ACL payload is
      BT_ACL_PAYLOAD. Off in the default image. BNEP is BT_CLASSIC_NAP.

config BT_ACL_PAYLOAD
    int "Classic ACL payload bytes"
    depends on BT_CLASSIC
    default 1695 if BT_CLASSIC_NAP
    default 1021
    range 259 1695
    help
      HCI ACL payload, including the 4-byte L2CAP header. 1021 offers an
      RFCOMM MTU of 1017. 1695 is what BNEP needs so the Configure Request
      can offer MTU 1691. The NAP image keeps 1695.

config BT_CLASSIC_NAP
    bool "Bluetooth Classic BNEP / NAP uplink"
    default n
    depends on BT_CLASSIC
    depends on NET_UPLINK
    help
      A PANU connection to a phone NAP, and a NAP the phone can call.
      The netif ("b0") joins the uplink choice with Wi-Fi, Ethernet and
      USB-NCM when the phone is sharing its network. Off unless this
      option is on.

config BT_PERIPHERAL
    bool "BLE peripheral beside the central"
    default n
    depends on BT_LE
    help
      Advertise a connectable peripheral while the central keeps scanning.
      Lua and a PEX module can replace the local service list at runtime.
      One of those services can be MCUmgr SMP, so an image can arrive over
      BLE as well as UDP 1337. Off in the default image, and the central
      path is unchanged while it is off.

config BT_MAX_LINKS
    int "Concurrent links (all transports)"
    default 4
    range 1 8
    help
      Sized so a Lua profile can hold a device while a browser independently
      pokes another. Each link costs roughly 1 KB of GATT database plus
      BTstack's own per-connection state.

config GATT_MAX_SVCS
    int "Max services cached per device"
    default 16

config GATT_MAX_CHRS
    int "Max characteristics cached per device"
    default 160
    help
      Real devices have far more than a handful. A Pinecil V2 exposes over a
      hundred across its live-data, bulk and settings services, and a cap below
      that silently returns a partial tree.

config GATT_MAX_DSCS
    int "Max descriptors cached per device"
    default 48

config GATT_MAX_UUID128
    int "Max distinct 128-bit UUIDs interned per device"
    default 96
    help
      BTstack hands us a full uuid128 in every service, characteristic and
      descriptor. Interning them per device is what keeps a typical peripheral
      at about 1 KB instead of several.

endmenu
```

## src/can/Kconfig
```kconfig
menu "CAN"

config CAN
    bool "CAN"
    default n
    help
      The shared CAN API, with one driver underneath. Specified and not
      built. Turning this on fails configure.

config CAN_TWAI
    bool "ESP32-C5 TWAI"
    default n
    depends on CAN
    depends on BOARD_ESP32_C5
    help
      The ESP32-C5 TWAI peripheral. The RP2350 and RP2040 have no TWAI
      block; they use CAN_MCP2515. Specified and not built. Turning this
      on fails configure.

config CAN_MCP2515
    bool "MCP2515 on SPI"
    default n
    depends on CAN
    depends on SPI_BUS
    help
      The SPI MCP2515, for the RP2350 and RP2040. Specified and not built.
      Turning this on fails configure.

config CAN_J1939
    bool "J1939"
    default n
    depends on CAN
    help
      J1939 on the shared CAN API, with either driver underneath.
      Specified and not built. Turning this on fails configure.

endmenu
```

## src/codec/Kconfig
```kconfig
menu "Device protocol primitives"

config PROTO_ANKER
    bool "Anker frame/TLV codec and session crypto"
    default y
    help
      The stable, byte-level half of the Anker protocol: the FF09 frame header
      and its XOR checksum, fragment reassembly, both TLV dialects, and the
      AES/GCM/ECDH the session cipher needs.

      This is device-named C, which looks like it contradicts the rule that
      device knowledge stays out of the firmware. It does not. The rule
      protects the generic Bluetooth core -- src/bt, src/ops, src/api,
      src/lua -- so the gateway stays useful for any peripheral. A byte codec
      that has been stable across three independent implementations is a
      primitive, not a policy. The opcodes, field dictionaries, handshake and
      keystream constants live in the Anker PEX module (and in lua/profiles,
      which is the behavior spec that module was ported from).

      Turn this off for a build that will never talk to Anker hardware and
      reclaim the flash. The Lua bindings disappear with it.

config PROTO_ANKER_CRYPTO
    bool "Session crypto (P-256 ECDH, AES, GCM)"
    depends on PROTO_ANKER
    default y
    help
      ECDH runs on the uECC that BTstack already links for LE Secure
      Connections, so it costs nothing extra; AES comes from a vendored
      tiny-AES-c at about 3 KB, and GCM is CTR over that plus a GHASH. mbedTLS
      would have done all of it and cost roughly 80 KB, because the SDK builds
      it for picotool rather than for the firmware.

      Without this only the frame and TLV codecs are built, which is enough to
      decode a plaintext capture but not to hold a session.

endmenu
```

## src/fs/Kconfig
```kconfig
menu "Filesystem"

config FS_MIGRATE
    bool "Migrate a pre-PEX LittleFS through the SD card"
    default n
    help
      One boot of a board whose LittleFS is still the old 2032 KiB layout.
      Copies every file to the SD card, verifies it, formats the smaller
      filesystem, and restores cfg/ before anything else is read. About 7 KB
      of flash. Off, that file is not linked.

      A filesystem already in the new layout is unchanged either way.
      fs_init() still mounts an old one as found. sys.info and the root of
      /api/fs then say "migration pending: not in this build", and the PEX
      partition stays inside that filesystem so nothing is written over it.
      Turn this on, with CONFIG_SD, for the boot that moves it. A build
      without the card reports the same pending state the migrator always
      did when the card was missing.

endmenu
```

## src/io/Kconfig
```kconfig
menu "I/O subsystems"

comment "Each module is independently gated: a deployed build that does not"
comment "need I2C/SPI bring-up tooling can drop it and reclaim the flash."

config IO_PINS
    bool "Pin broker"
    default n
    help
      NOT IMPLEMENTED YET (phase 7). Arbitrates GPIO between subsystems and
      scripts, hard-reserves the CYW43439's pins (23/24/25/29 on Pico 2 W --
      claiming one kills Wi-Fi AND Bluetooth), and releases every claim a
      script made when that script stops. Everything below depends on it.

config IO_GPIO
    bool "GPIO"
    depends on IO_PINS
    default n

config IO_ADC
    bool "ADC"
    depends on IO_PINS
    default n

config IO_PWM
    bool "PWM"
    depends on IO_PINS
    default n

config IO_I2C
    bool "I2C (with bus scan)"
    depends on IO_PINS
    default n

config IO_SPI
    bool "SPI"
    depends on IO_PINS
    default n

config IO_UART
    bool "Hardware UART"
    depends on IO_PINS
    default n

config IO_CDC
    bool "USB CDC-ACM data ports"
    default n

endmenu
```

## src/lua/Kconfig
```kconfig
menu "Lua scripting"

config LUA_ENABLE
    bool "Lua runtime"
    default n
    help
      The Lua runtime. Device profiles can live on LittleFS and be changed
      without a program/erase cycle. It is optional: PEX apps run with this
      off, and the editor's Run button is the part of the UI that needs it.
      The symbol defaults off. The Pico product defconfigs turn it on. An
      ESP32-C5 image leaves it off and can turn it on later.

config LUA_HEAP_KB
    int "Lua arena (KB)"
    depends on LUA_ENABLE
    default 160
    help
      A dedicated static arena, not the system heap, so a runaway script hits
      its own ceiling with an ordinary Lua out-of-memory error instead of
      starving lwIP or BTstack. Static so the link-time RAM check can see it.

      Raised from 96 after measurement, not guesswork. COMPILING a module
      costs far more than running it: the 28 KB A2687 profile peaks at 82 KB
      of arena while the parser works, against about 14 KB once it is
      resident. At 96 KB that loaded only into a completely empty arena and
      failed with "not enough memory" the moment any other script was also
      loaded -- which is the normal state of a board being worked on.

      The bytes are .bss. On the SD + Classic link the heap gap under
      __end__ is the scarce resource, so this arena and the PEX pool move
      together and keep a constant sum.

      Raised again to 160 for the advertisement-driven Anker stack, and this
      time the earlier advice -- split it into modules rather than raise the
      ceiling -- had already been taken and was not enough. That stack loads
      one module per stage and unloads each before the next compiles, so the
      COMPILE peak is well under control. What is left is steady residency:
      the driver, the link, the schema decoder and one per-model table come
      to about 74 KB live while streaming.

      The failure at 128 KB was not exhaustion but FRAGMENTATION -- roughly
      56 KB free and still no block large enough, after a report that builds
      ~68 TLV item tables every few seconds. Live heap was flat across polls,
      which is how you tell the two apart. A first-fit arena cannot do much
      about that except have room to breathe.

      That profile is gone. Images without the SD card stay at 100 KB here
      and 64 KB in CONFIG_PEX_POOL_KB. pico2w_sd, pico2w_sdspi, and
      pico2w_pexcc keep the W5500 and set this arena to 64 KB, because
      100 KB does not link on that image. On the images that stay at 100 KB,
      16 KB moved to the PEX pool and the sum stays 164 KB. pico2w_noanker
      stays at 96 KB with the pool taken from the C heap. The default above
      is still 160.

config LUA_HOOK_BUDGET
    int "Instructions per scheduler slice before a script is forced to yield"
    depends on LUA_ENABLE
    default 20000

endmenu
```
