## src/net/Kconfig
```kconfig
menu "Networking"

config NET_WIFI
    bool "Wi-Fi (station + SoftAP)"
    default y
    depends on RADIO_CYW43
    help
      Compiles the cyw43 station/AP state machine, the /api/wifi routes and
      the credential store in or out entirely. The Bluetooth stack shares the
      same CYW43439 but does not depend on this: a BLE-only build is valid and
      is reachable over USB-NCM.

config NET_USB_NCM
    bool "USB-NCM (Ethernet over the USB cable)"
    default y
    help
      A network interface over the target's own USB port. Worth keeping even
      on a Wi-Fi build: it is reachable before Wi-Fi is configured and when the
      access point is down, which is the difference between a bad Wi-Fi setting
      being an annoyance and being a reflash.

comment "USB-NCM /24: device takes .1, the host is handed .16 by DHCP."
comment "MUST NOT collide with another NCM device on the same host -- the bench"
comment "this was developed on already had an unrelated project on 192.168.7.x,"
comment "and two NCM interfaces sharing a subnet is a routing coin-toss."

config NET_NCM_IP0
    int "USB-NCM subnet octet 1"
    depends on NET_USB_NCM
    default 192

config NET_NCM_IP1
    int "USB-NCM subnet octet 2"
    depends on NET_USB_NCM
    default 168

config NET_NCM_IP2
    int "USB-NCM subnet octet 3"
    depends on NET_USB_NCM
    default 8

config NET_MDNS
    bool "mDNS responder"
    default y

config NET_HOSTNAME
    string "mDNS / DHCP hostname"
    default "bluetooth-rp2-webapp"
    help
      The project name, spelled as a DNS label: a hostname may contain only
      letters, digits and hyphens, so the underscores in "bluetooth_rp2_webapp"
      become hyphens. Reachable as <name>.local once mDNS is up.

config NET_HTTP_SERVER
    bool "HTTP server and WebSocket API"
    default y
    help
      The page on port 80 and the websocket at /ws (src/net/http.c and
      src/net/ws.c). The op table in src/api/ops.c stays in every image.
      This server is one caller of it. On in every current RP2350 image.
      A later target can leave it off.

config NET_HTTP_CLIENT
    bool "HTTP client for Lua scripts (http.start)"
    depends on LUA_ENABLE
    default y
    help
      An HTTP/1.1 client on raw lwIP TCP (src/net/httpc.c) for the Lua
      `http` module: DNS, Content-Length and chunked bodies, redirects,
      streaming into a LittleFS or SD file, timeouts, several requests at
      once. Turns lwIP's DNS client on. Requests and their buffers live in
      the Lua arena, not in static RAM.

config NET_HTTP_TLS
    bool "HTTPS (mbedTLS, TLS 1.2 client)"
    depends on NET_HTTP_CLIENT
    default y
    help
      https:// for the HTTP client: mbedTLS cut down to a TLS 1.2 client
      (ECDHE with AES-GCM; RSA and ECDSA certificates; include/
      mbedtls_config.h), verified against an embedded set of roots
      (src/net/ca_roots.h: Google Trust Services R1-R4, GlobalSign R1,
      ISRG X1/X2). A session lives in the TLS pool below, never in the Lua
      arena. Costs about 70 KB of flash.

config NET_TLS_POOL_KB
    int "TLS pool (KB)"
    depends on NET_HTTP_TLS
    default 40
    help
      Static memory of its own, apart from the Lua arena, for the HTTP
      client's one TLS session at a time -- mbedTLS's record buffers
      (16 KiB in: servers ignore max_fragment_length; 2 KiB out), the
      handshake state, the server's chain and the trusted roots while it is
      verified -- and every request's bookkeeping (URL, header and request
      text copies). An https:// request that finds the session taken waits
      for it before it connects.

      Sized from measurement (mcusim, a BLE firmware-update backend against cloud storage and
      a REST database, both verified): a session peaks at about 31-33 KB. Before
      this pool the session came from the Lua arena, where a long-running
      script's objects left no 17 KB hole for the receive buffer and HTTPS
      failed "out of memory" with plenty of bytes free. In the shipped
      configs the arena went from 176 to 164 KB: 40 KB to this pool, 28 KB
      back from lwIP (include/lwipopts.h, MEASURED).

config NET_SNTP
    bool "SNTP wall-clock time (sys.time)"
    default y
    help
      lwIP's SNTP client polling pool.ntp.org (or cfg/ntp.json's "server")
      hourly. Gives Lua sys.time() and lets TLS check certificate dates.

config NET_WIREGUARD
    bool "WireGuard tunnel (an additional route, never the only one)"
    default n
    help
      A WireGuard client, so the device can be reached from outside the
      local network. The tunnel netif is never made lwIP's default route:
      USB-NCM and WiFi keep working whatever the tunnel is doing, because a
      remote-access path that can strand the device is worse than none.

      Keys and the peer endpoint come from cfg/wireguard.json on LittleFS,
      which is git-ignored and which the HTTP filesystem routes refuse to
      serve. Nothing is compiled in.

      Costs about 25 KB of flash (the implementation plus ChaCha20-Poly1305,
      BLAKE2s and X25519) and a few KB of RAM for one peer.

config NET_ETH_W5500
    bool "Ethernet: WIZnet W5500 on SPI (an optional second uplink)"
    default n
    select SPI_BUS
    help
      A W5500 in MACRAW mode as lwIP netif "e0": lwIP does ARP, IP and the
      DHCP client; the chip only moves frames. Optional in the same way WiFi
      is -- a build without it carries none of its code. The SPI traffic
      goes through src/io/spibus.c (semaphore-claimed bus, DMA in the
      background, completion from the main loop), so nothing ever waits on
      the chip. A board without the module fitted reports "not present" and
      touches nothing else.

      Costs about 12 KB of flash and ~1 KB of static RAM; frames in flight
      live in lwIP's own pools.

if NET_ETH_W5500

config ETH_W5500_SPI
    int "SPI block (0 or 1)"
    range 0 1
    default 1

config ETH_W5500_SCK
    int "SCK pin"
    default 14

config ETH_W5500_MOSI
    int "MOSI (TX) pin"
    default 15

config ETH_W5500_MISO
    int "MISO (RX) pin"
    default 8

config ETH_W5500_CS
    int "CS pin (driven as a plain GPIO)"
    default 13

config ETH_W5500_INT
    int "INT pin (-1 = none, poll only)"
    default 10

config ETH_W5500_RST
    int "RST pin (-1 = none, soft reset through MR)"
    default 11

config ETH_W5500_BAUD
    int "SPI clock (Hz)"
    default 30000000

config ETH_W5500_MAC_FILTER
    bool "Hardware MAC filter (own MAC + broadcast + multicast only)"
    default y
    help
      Sn_MR.MFEN. Off makes the socket promiscuous: harmless on a switched
      LAN, but every flooded unicast frame then crosses the SPI bus.

endif

config NET_UPLINK
    bool
    default y if NET_WIFI || NET_ETH_W5500
    help
      Uplink health and selection (src/net/uplink.c): the ONLY code that
      calls netif_set_default(). Pings the WireGuard endpoint on every
      interface with a gateway and moves the tunnel and new connections to
      the best one.

config NET_GW_LAN
    bool "Gateway LAN"
    default n
    depends on NET_ETH_W5500
    help
      The gateway LAN. The first carrier is the W5500 netif e0. The
      choice is cfg/gw.json: an interface name, or "none". A missing file
      uses e0 when the W5500 is built in, and none otherwise. A stored
      "none" stays none. Link-local (169.254/16) stays up for the whole
      time the link is up. A DHCP lease is a second address. A DHCP
      router on this LAN is a local uplink only, and it is not advertised.
      Each board probes that router itself. Specified and not built.
      Turning this on fails configure.

config NET_MDNS_GW
    bool "Gateway LAN mDNS (_btgw-gw._udp)"
    default n
    depends on NET_MDNS
    depends on NET_GW_LAN
    help
      One _btgw-gw._udp.local instance per internet connection that has a
      gateway and is not the DHCP router on the gateway LAN. Instance
      name <hostname>-<iface>. TXT carries iface and metric=<upl_metric>.
      Wi-Fi, USB-NCM, and Bluetooth NAP are separate instances. Sent about
      every 2 seconds. A board that hears nothing new for an instance for
      6 seconds drops that one connection. Other connections from the same
      board stay. Specified and not built. Turning this on fails configure.

config NET_NAT
    bool "NAT from the gateway LAN"
    default n
    depends on NET_GW_LAN
    depends on NET_UPLINK
    help
      Masquerade from the gateway LAN out the uplink named by a heard
      _btgw-gw instance. The next hop is the announcer's link-local
      address. This is not the Lua TCP/UDP proxy (NET_FORWARD). Specified
      and not built. Turning this on fails configure.

config NET_FORWARD
    bool "Forwarding rules from Lua (TCP proxy + UDP relay)"
    default n
    depends on LUA_ENABLE
    help
      net.forward{} from a script: a listen port relayed to another port on
      this device or to a host on any interface. Not IP forwarding: the
      gateway terminates and re-originates, so replies come back on the
      same pair whatever the interfaces. Rules belong to the script that
      made them.

      Off unless a defconfig sets it. About 7 KB of flash, and it is what
      pulls in lwIP's loopback interface. The launchers that only pex.start
      do not call it.

config LWIP_MEM_SIZE_KB
    int "lwIP heap (KB)"
    default 48
    help
      lwIP's transmit heap. 48 KB suits RP2350's 520 KB SRAM; drop to 32 on an
      RP2040. Every other lwIP setting lives in include/lwipopts.h and must be
      changed there, never as a -D: those are unconditional #defines and win
      silently.

endmenu
```

## src/ota/Kconfig
```kconfig
menu "OTA updates"

config OTA
    bool "MCUmgr/SMP server and A/B firmware slots (RP2350 boot ROM)"
    default n
    help
      Firmware updates over UDP port 1337 with the MCUmgr protocol (smpmgr,
      mcumgr-client, nRF Connect Device Manager). Images land in the other
      of two boot-ROM A/B partitions, are checked against the ECDSA public
      key in src/ota/ota_pubkey.h, and boot try-before-you-buy: the ROM
      reverts to the old slot unless the new firmware buys itself after a
      healthy start. Also exposes the os, stat and fs groups. Requires the
      partition table in partitions.json to be provisioned once (tools/
      provision.sh).

endmenu
```

## src/pex/Kconfig
```kconfig
menu "PEX native modules"

config PEX
    bool "PEX loader (native modules from LittleFS)"
    default y
    help
      The PEX runtime (pex/runtime, docs/pex-format.md): load .pex modules
      from LittleFS into RAM and run them -- apps on the main loop, native Lua
      modules, ops for the web UI. It costs no RAM until a module is first
      loaded: the pool is taken from the C heap then, after a headroom check.
      Nothing runs at boot unless the launch list says so.

config PEX_POOL_KB
    int "PEX pool, static (KB; 0 = take a small one from the C heap)"
    depends on PEX
    default 0
    help
      Module RW, the modules' long-term memory, scratch arenas and pools,
      and the code of modules loaded into RAM (spec 7.2). A static block of
      its own: apart from the Lua arena (a Lua VM restart never touches it)
      and from the C heap. The shipped configs take it out of the Lua
      arena's budget (CONFIG_LUA_HEAP_KB) now that native modules do the
      work and Lua is a launcher; installed modules (XIP) need only their
      RW here.

      0 keeps the v1 behaviour: a pool of up to PEX_HEAP_POOL_KB taken from
      the C heap on first use.

config PEX_HEAP_POOL_KB
    int "PEX pool from the C heap (KB)"
    depends on PEX && PEX_POOL_KB = 0
    default 12
    help
      Only without a static pool: taken on first use from the C heap, as
      much as this but never leaving less than PEX_HEAP_RESERVE_KB free (the
      SD build has ~19 KB of C heap once booted, and pico_malloc panics when
      it runs out), and at least 6 KB.

config PEX_HEAP_RESERVE_KB
    int "C heap kept free when the pool is taken (KB)"
    depends on PEX && PEX_POOL_KB = 0
    default 8
    help
      pico_malloc panics on ANY failed allocation, so the rest of the
      firmware keeps this much. The pool is taken with newlib's own malloc
      (no panic) and shrinks to fit, down to 6 KB.

config PEX_XIP
    bool "Install modules into the PEX flash partition and run them in place"
    depends on PEX
    default y
    help
      pex.install writes a module into the PEX partition (fs.h FS_PEX_OFF,
      256 KB at 0x3BC000 on the 4 MB part), with an index kept power-fail
      safe (two copies, sequence numbers); an installed module loads with
      its code in flash (executed through QMI ATRANS1 on RP2350) and only
      its RW in the pool. pex.load prefers the installed copy.

config PEX_ALLOW_UNSIGNED
    bool "Load unsigned modules (development)"
    depends on PEX
    default y if !OTA
    default n
    help
      Off: only modules signed with the OTA key (tools/ota_sign.py, pexlink
      --sign) load. On: unsigned ones too, and pex.list says so. A build
      without OTA has no key to check signatures with, so it defaults on.

config PEX_LUA
    bool "Lua launcher and require for PEX modules"
    depends on PEX && LUA_ENABLE
    default y

config PEX_SLICE_MS
    int "Abort a PEX call that runs longer than this (ms)"
    depends on PEX
    range 0 4000
    default 500
    help
      Every module shares the main loop. A call into a module that does not
      return within this many milliseconds is stopped: that module is marked
      faulted, its tasks are cancelled, the event is recorded in
      var/pex_faults.json, and the loop continues with the other modules and
      the rest of the firmware. 0 leaves only the watchdog, which resets the
      whole board. The watchdog still does that if the module runs with
      interrupts masked, because the slice is a timer interrupt.

endmenu
```

## src/radio/Kconfig
```kconfig
menu "Radios"

config RADIO_CYW43
    bool "CYW43439 radio (Pico W Wi-Fi and Bluetooth)"
    default y if BOARD_PICO2_W
    help
      Links pico_cyw43_arch_lwip_poll and the USB-servicing wrap of
      cyw43_await_background_or_timeout_us. NET_WIFI and BT_LE on the Pico
      use this chip. A later target leaves it off. Current Pico images
      keep it.

config IEEE802154
    bool "802.15.4 MAC"
    default n
    help
      The 802.15.4 MAC. On the ESP32-C5 this is the built-in radio. There
      is no RP2350 driver. Specified and not built. Turning this on fails
      configure.

config NET_THREAD
    bool "Thread over 802.15.4"
    default n
    depends on IEEE802154
    help
      Thread on the 802.15.4 MAC. Specified and not built. Turning this
      on fails configure.

endmenu
```
